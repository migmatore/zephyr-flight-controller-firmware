## CMakeLists.txt
```
#list(APPEND ZEPHYR_EXTRA_MODULES ${CMAKE_CURRENT_SOURCE_DIR}/drivers/)
set(ZEPHYR_EXTRA_MODULES ${CMAKE_CURRENT_SOURCE_DIR}/drivers/spi/nrf24l01)
cmake_minimum_required(VERSION 3.20.0)

#set(ZEPHYR_BASE "~/zephyrproject/zephyr/")
set(BOARD nucleo_f303re)
set(CONF_FILE prj.conf)
set(DTC_OVERLAY_FILE overlay/bme280.overlay)
list(APPEND DTC_OVERLAY_FILE overlay/nrf24l01.overlay)

find_package(Zephyr REQUIRED HINTS $ENV{ZEPHYR_BASE})

project(z_app)
target_sources(app PRIVATE src/main.c)
```

## prj.conf
```kconfig
CONFIG_GPIO=y
CONFIG_I2C=y
CONFIG_SPI=y
CONFIG_SENSOR=y

CONFIG_THREAD_NAME=y
CONFIG_THREAD_MONITOR=y

CONFIG_PRINTK=y
CONFIG_HEAP_MEM_POOL_SIZE=256

CONFIG_EVENTS=y

CONFIG_NRF24L01_DRIVER=y
CONFIG_APPLICATION_DEFINED_SYSCALL=y
```

## dts/bindings/spi/nordic,nrf24l01.yaml
```yaml
description: nrf24l01

compatible: "nordic,nrf24l01"

include: [spi-device.yaml]

properties:
  ce-gpios:
    type: phandle-array
    required: true
    description: Interrupt pin.
      
      The interrupt pin of W5500 is active low.
      If connected directly the MCU pin should be configured
      as active low.
  int-gpios:
    type: phandle-array
    required: false
    description: Reset pin.
      
      The reset pin of W5500 is active low.
      If connected directly the MCU pin should be configured
      as active low.
```

## src/main.c
```c
#include "nrf24l01.h"
#include <zephyr/zephyr.h>

void main() {
    const struct device *dev = DEVICE_DT_GET_ANY(nordic_nrf24l01);

    if (dev == NULL) {
        /* No such node, or the node does not have status "okay". */
        printk("\nError: no device found.\n");
        return;
    }

    if (!device_is_ready(dev)) {
        printk("\nError: Device \"%s\" is not ready; "
               "check the driver initialization logs for errors.\n",
               dev->name);
        return;
    }

    printk("Found device \"%p\", name \"%s\"\n", dev, dev->name);
}
```
