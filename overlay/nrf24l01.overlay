&spi1 {
    status = "okay";

    cs-gpios = <&gpioa 4 GPIO_ACTIVE_LOW>;

    nrf24l01: nrf24l01@0 {
        compatible = "nordic,nrf24l01";
        spi-max-frequency = <4000000>;
        reg = <0>;
        ce-gpios = <&gpioa 1 GPIO_ACTIVE_HIGH>;
        int-gpios = <&gpioa 0 GPIO_ACTIVE_LOW>;
    };
};
