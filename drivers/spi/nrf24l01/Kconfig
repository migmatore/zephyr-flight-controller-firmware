## drivers/spi/nrf24l01/Kconfig
```kconfig
 menuconfig NRF24L01_DRIVER
         bool "Ololo driver"
         default y

 if NRF24L01_DRIVER

 module = NRF24L01_DRIVER
 module-str = nrf24l01_driver


 endif
```
